## src/examples/serial_probe/Kconfig
```kconfig
menuconfig EXAMPLES_SERIAL_PROBE
    bool "serial_probe"
    default n
    ---help---
        Parse zhongkeyoucheng / aisheng DYT telemetry from a serial port into uORB.
```

## src/examples/serial_probe_processor/Kconfig
```kconfig
menuconfig EXAMPLES_SERIAL_PROBE_PROCESSOR
    bool "serial_probe_processor"
    default n
    ---help---
        Independently subscribe to serial_probe_request and publish value+1 responses.
```

## src/modules/simulation/aisheng_udp_bridge/Kconfig
```kconfig
menuconfig MODULES_SIMULATION_AISHENG_UDP_BRIDGE
	bool "aisheng_udp_bridge"
	default n
	depends on PLATFORM_POSIX
	---help---
		Receive complete ASD-2-075-DD0 JSON telemetry over UDP in SITL.
		The two-axis seeker continues to use the independent dyt_udp_bridge.
```

## src/modules/simulation/dyt_udp_bridge/Kconfig
```kconfig
menuconfig MODULES_SIMULATION_DYT_UDP_BRIDGE
	bool "dyt_udp_bridge"
	default n
	depends on PLATFORM_POSIX
	---help---
		Receive Aisheng JSON telemetry over UDP and publish it as uORB data.
		This bridge is intended for SITL only.
```

## src/modules/simulation/zhongke_udp_bridge/Kconfig
```kconfig
menuconfig MODULES_SIMULATION_ZHONGKE_UDP_BRIDGE
	bool "zhongke_udp_bridge"
	default n
	depends on PLATFORM_POSIX
	---help---
		Receive Zhongke D80 ground station JSON telemetry over UDP in SITL.
		Publish the measurements to dyt_zhongke_telemetry.
```

## src/modules/strike_model_tyfw/Kconfig
```kconfig
menuconfig MODULES_STRIKE_MODEL_TYFW
	bool "STRIKE_MODEL_TYFW"
	default y
	---help---
		Enable support for STRIKE_MODEL_TYFW
```
